## build/Kconfig/boards/Kconfig.defconfig.tmp
```kconfig
# Load Zephyr board defconfig descriptions.
osource "D:/ncs/v3.4.0/zephyr/boards/nordic/nrf5340dk/Kconfig.defconfig"
```

## build/ble_light_project/Kconfig/boards/Kconfig.nrf5340dk
```kconfig
# Load board Kconfig descriptions.
osource "D:/ncs/v3.4.0/zephyr/boards/nordic/nrf5340dk/Kconfig.nrf5340dk"
```

## build/ble_light_project/Kconfig/boards/Kconfig.sysbuild.tmp
```kconfig
# Load Sysbuild board Kconfig descriptions.
osource "D:/ncs/v3.4.0/zephyr/boards/nordic/nrf5340dk/Kconfig.sysbuild"
```
