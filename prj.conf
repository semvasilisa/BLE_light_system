## CMakeLists.txt
```
cmake_minimum_required(VERSION 3.20.0)

find_package(Zephyr REQUIRED HINTS $ENV{ZEPHYR_BASE})
project(smart_lighting)

target_sources(app PRIVATE
    src/main.c
    src/light.c
)
```

## prj.conf
```kconfig
CONFIG_BT=y
CONFIG_BT_PERIPHERAL=y
CONFIG_BT_DEVICE_NAME="SmartLight"

CONFIG_BT_SMP=y
CONFIG_DK_LIBRARY=y

CONFIG_LOG=y
CONFIG_PWM=y
```

## src/main.c
```c
#include <zephyr/kernel.h>
#include <zephyr/logging/log.h>
#include <zephyr/bluetooth/conn.h>
#include <dk_buttons_and_leds.h>
#include <zephyr/bluetooth/bluetooth.h>
#include "light.h"

#define DEVICE_NAME CONFIG_BT_DEVICE_NAME
#define DEVICE_NAME_LEN (sizeof(DEVICE_NAME) - 1)

LOG_MODULE_REGISTER(main, LOG_LEVEL_INF);

// what we will send in the advertising packet
static const struct bt_data ad[] = {
    BT_DATA_BYTES(BT_DATA_FLAGS, BT_LE_AD_NO_BREDR),
    BT_DATA(BT_DATA_NAME_COMPLETE, DEVICE_NAME, DEVICE_NAME_LEN),
};

// configuration for advertising parameters
static const struct bt_le_adv_param *adv_param =
    BT_LE_ADV_PARAM(BT_LE_ADV_OPT_CONN, // no special advertising options, makes the advert connectable
                     400,  // min advertising interval: 400 * 0.625ms = 250 ms 
                     401,  // max advertising interval: 401 * 0.625ms = 250.625 ms
                     NULL); // no specific device is targeted (undirected) 

struct bt_conn *current_conn;

// a device is connected, get info about this connection
static void connected(struct bt_conn *conn, uint8_t err) // conn tells which BLE connection
{
    if (err) {
        LOG_ERR("Connection failed (err %u)\n", err);
        return;
    }

    LOG_INF("Connected\n");
    current_conn = bt_conn_ref(conn);

    struct bt_conn_info info; // all info about the connection 
    err = bt_conn_get_info(conn, &info);
    if (err) {
        LOG_ERR("Failed to get connection info (err %d)\n", err);
        return;
    }

    // return connection interval, peripheral latency, and supervision timeout
    LOG_INF("Connection interval: %u units (%u ms)\n",
            info.le.interval, info.le.interval * 5 / 4);
    LOG_INF("Peripheral latency: %u\n", info.le.latency);
    LOG_INF("Supervision timeout: %u units (%u ms)\n",
            info.le.timeout, info.le.timeout * 10);
}

static void disconnected(struct bt_conn *conn, uint8_t reason)
{
    LOG_INF("Disconnected (reason %u)\n", reason);

    if (current_conn) {
        bt_conn_unref(current_conn);
        current_conn = NULL;
    }
    // restart advertising after disconnection
    // int err = bt_le_adv_start(adv_param, ad, ARRAY_SIZE(ad), NULL, 0);
    // if (err) {
    //     LOG_ERR("Advertising failed to restart (err %d)\n", err);
    // }
}

static void recycled(void)
{
    int err = bt_le_adv_start(adv_param, ad, ARRAY_SIZE(ad), NULL, 0);

    if (err) {
        LOG_ERR("Advertising failed to restart (err %d)", err);
    } else {
        LOG_INF("Advertising restarted");
    }
}

static void on_security_changed(struct bt_conn *conn, bt_security_t level,
			     enum bt_security_err err)
{
	char addr[BT_ADDR_LE_STR_LEN];

	bt_addr_le_to_str(bt_conn_get_dst(conn), addr, sizeof(addr));

	if (!err) {
		LOG_INF("Security changed: %s level %u\n", addr, level);
	} else {
		LOG_INF("Security failed: %s level %u err %d\n", addr, level,
			err);
	}
}

static void auth_passkey_display(struct bt_conn *conn, unsigned int passkey)
{
	char addr[BT_ADDR_LE_STR_LEN];
	bt_addr_le_to_str(bt_conn_get_dst(conn), addr, sizeof(addr));
	LOG_INF("Passkey for %s: %06u\n", addr, passkey);
}

static void auth_cancel(struct bt_conn *conn)
{
	char addr[BT_ADDR_LE_STR_LEN];
	bt_addr_le_to_str(bt_conn_get_dst(conn), addr, sizeof(addr));
	LOG_INF("Pairing cancelled: %s\n", addr);
}

static struct bt_conn_cb connection_callbacks = {
        .connected = connected,
        .disconnected = disconnected,
        .recycled = recycled,
        .security_changed = on_security_changed,
};

static struct bt_conn_auth_cb conn_auth_callbacks = {
	.passkey_display = auth_passkey_display,
	.cancel = auth_cancel,
};

int main(void)
{
    int err;

    err = dk_leds_init(); // preprare the board's led so that they could be used by the program
    if (err) {
        LOG_ERR("LEDs init failed (err %d)\n", err);
        return err;
    }

    err = dk_buttons_init(button_changed);
    if (err) {
        LOG_ERR("Buttons init failed (err %d)\n", err);
        return err;
    }

    err = bt_conn_auth_cb_register(&conn_auth_callbacks);
    if (err) {
        LOG_INF("Failed to register authorization callbacks.\n");
        return -1;
    }

    err = bt_enable(NULL); // starts the ble host
    if (err) {
        LOG_INF("Bluetooth init failed (err %d)\n", err);
        return err;
    }

    LOG_INF("Bluetooth initialized\n");

    bt_conn_cb_register(&connection_callbacks);
    // start advertising
    err = bt_le_adv_start(adv_param, ad, ARRAY_SIZE(ad), NULL, 0);
    if (err) {
        LOG_ERR("Advertising failed to start (err %d)\n", err);
        return err;
    }

    printk("Advertising successfully started as %s\n", DEVICE_NAME);

    return 0;
}
```

## src/light.c
```c
#include <zephyr/kernel.h>
#include <zephyr/logging/log.h>
#include <zephyr/bluetooth/gatt.h>
#include <zephyr/bluetooth/uuid.h>
#include <zephyr/drivers/pwm.h>
#include <dk_buttons_and_leds.h>
#include "light.h"

LOG_MODULE_REGISTER(light, LOG_LEVEL_INF);

#define LIGHT_LED DK_LED1

static const struct pwm_dt_spec led_pwm = PWM_DT_SPEC_GET(DT_ALIAS(pwm_led0));

extern struct bt_conn *current_conn;

static void update_status_notify(struct bt_conn *conn);

// variable to preserve current state, three together because read_status returns three values as one
struct light_state {
    uint8_t power;      // 0 = off, 1 = on 
    uint8_t brightness; // 0-255 
    uint8_t mode;        // 0 = steady, 1 = slow blink, 2 = fast blink 
};

static struct light_state light_state = {
    .power = 0,
    .brightness = 255,
    .mode = 0,
};

static bool led_is_on = false;

void apply_brightness(void){
    
    uint32_t pulse_width = ((uint64_t)light_state.brightness * led_pwm.period) / 255;

    int err = pwm_set_pulse_dt(&led_pwm, pulse_width);
    if (err) {
        LOG_WRN("Failed to set brightness (err %d)", err);
    }
}

void apply_led_off(void)
{
    int err = pwm_set_pulse_dt(&led_pwm, 0);
    if (err) {
        LOG_WRN("Failed to turn off LED (err %d)", err);
    }
}

void toggle_light_led(void)
{
    if (led_is_on) {
        apply_led_off();
        led_is_on = false;
    } else {
        apply_brightness();
        led_is_on = true;
    }
}

static void led_timer_expiry(struct k_timer *timer)
{
    toggle_light_led();
}

K_TIMER_DEFINE(led_timer, led_timer_expiry, NULL);

static void apply_light_state(void)
{
    k_timer_stop(&led_timer);

    if (!light_state.power) {
        apply_led_off();
        return;
    }

    /* Power is on */
    if (light_state.mode == 0) {
        apply_brightness();
    }
   
    if (light_state.mode == 1) {
        k_timer_start(&led_timer, K_MSEC(1000), K_MSEC(1000));
    }
    else if (light_state.mode == 2) {
        k_timer_start(&led_timer, K_MSEC(500), K_MSEC(500));
    }
}

static ssize_t write_power(struct bt_conn *conn, const struct bt_gatt_attr *attr,
                            const void *buf, uint16_t len, uint16_t offset, uint8_t flags)
{
    if(len != 1){ // we're expecting exactly one byte for power value
        return BT_GATT_ERR(BT_ATT_ERR_INVALID_ATTRIBUTE_LEN);
    }

    uint8_t val = ((uint8_t *)buf)[0]; // get the first byte from the buffer
    light_state.power = val;
    LOG_INF("Power set to %u", light_state.power);
    apply_light_state();
    update_status_notify(conn);
    // LOG_INF("write_power called, len=%u", len);
    return len;
}

static ssize_t write_brightness(struct bt_conn *conn, const struct bt_gatt_attr *attr,
                                 const void *buf, uint16_t len, uint16_t offset, uint8_t flags)
{
    if(len != 1){ 
        return BT_GATT_ERR(BT_ATT_ERR_INVALID_ATTRIBUTE_LEN);
    }

    light_state.brightness = ((uint8_t *)buf)[0];
    LOG_INF("Brightness set to %u", light_state.brightness);
    apply_light_state();
    update_status_notify(conn);
    // LOG_INF("write_brightness called, len=%u", len);
    return len;
}

static ssize_t write_mode(struct bt_conn *conn, const struct bt_gatt_attr *attr,
                           const void *buf, uint16_t len, uint16_t offset, uint8_t flags)
{
     if(len != 1){ 
        return BT_GATT_ERR(BT_ATT_ERR_INVALID_ATTRIBUTE_LEN);
    }

    light_state.mode = ((uint8_t *)buf)[0];
    LOG_INF("Mode set to %u", light_state.mode);
    apply_light_state();
    update_status_notify(conn);
    // LOG_INF("write_mode called, len=%u", len);
    return len;
}

static ssize_t read_status(struct bt_conn *conn, const struct bt_gatt_attr *attr,
                            void *buf, uint16_t len, uint16_t offset)
{
    return bt_gatt_attr_read(conn, attr, buf, len, offset,
                              &light_state, sizeof(light_state));
}

static void status_ccc_cfg_changed(const struct bt_gatt_attr *attr, uint16_t value)
{
    bool notify_enabled = (value == BT_GATT_CCC_NOTIFY);
    LOG_INF("Status notifications %s", notify_enabled ? "enabled" : "disabled");
}

void button_changed(uint32_t button_state, uint32_t has_changed)
{
    if (has_changed & DK_BTN1_MSK) {
        if (button_state & DK_BTN1_MSK) {
            /* Button 1 was just pressed */
            light_state.power = !light_state.power;
            LOG_INF("Button 1 pressed - power toggled to %u", light_state.power);

            apply_light_state();
            update_status_notify(current_conn);
        }
    }
}

BT_GATT_SERVICE_DEFINE(smart_light_svc,
    BT_GATT_PRIMARY_SERVICE(BT_UUID_SMARTLIGHT),

    BT_GATT_CHARACTERISTIC(BT_UUID_SMARTLIGHT_POWER,
        BT_GATT_CHRC_WRITE,
        BT_GATT_PERM_WRITE_AUTHEN,
        NULL, write_power, NULL),

    BT_GATT_CHARACTERISTIC(BT_UUID_SMARTLIGHT_BRIGHTNESS,
        BT_GATT_CHRC_WRITE,
        BT_GATT_PERM_WRITE,
        NULL, write_brightness, NULL),

    BT_GATT_CHARACTERISTIC(BT_UUID_SMARTLIGHT_MODE,
        BT_GATT_CHRC_WRITE,
        BT_GATT_PERM_WRITE,
        NULL, write_mode, NULL),

    BT_GATT_CHARACTERISTIC(BT_UUID_SMARTLIGHT_STATUS,
        BT_GATT_CHRC_READ | BT_GATT_CHRC_NOTIFY,
        BT_GATT_PERM_READ,
        read_status, NULL, NULL),
    BT_GATT_CCC(status_ccc_cfg_changed, BT_GATT_PERM_READ | BT_GATT_PERM_WRITE),
);

static void update_status_notify(struct bt_conn *conn)
{
    if (!conn) {
        return;
    }

    int err = bt_gatt_notify(conn, &smart_light_svc.attrs[8],
                              &light_state, sizeof(light_state));
    if (err) {
        LOG_WRN("Status notify failed (err %d)", err);
    }
}
```

## src/light.h
```c
#ifndef LIGHT_H_
#define LIGHT_H_

#include <zephyr/bluetooth/uuid.h>

/** @brief Smart Light Service UUID. */
#define BT_UUID_SMARTLIGHT_VAL \ 
    BT_UUID_128_ENCODE(0x00002000, 0x1212, 0xefde, 0x1523, 0x785feabcd123)

/** @brief Power Characteristic UUID (Write). */
#define BT_UUID_SMARTLIGHT_POWER_VAL \
    BT_UUID_128_ENCODE(0x00002001, 0x1212, 0xefde, 0x1523, 0x785feabcd123)

/** @brief Brightness Characteristic UUID (Write). */
#define BT_UUID_SMARTLIGHT_BRIGHTNESS_VAL \
    BT_UUID_128_ENCODE(0x00002002, 0x1212, 0xefde, 0x1523, 0x785feabcd123)

/** @brief Mode Characteristic UUID (Write). */
#define BT_UUID_SMARTLIGHT_MODE_VAL \
    BT_UUID_128_ENCODE(0x00002003, 0x1212, 0xefde, 0x1523, 0x785feabcd123)

/** @brief Status Characteristic UUID (Read + Notify). */
#define BT_UUID_SMARTLIGHT_STATUS_VAL \
    BT_UUID_128_ENCODE(0x00002004, 0x1212, 0xefde, 0x1523, 0x785feabcd123)

#define BT_UUID_SMARTLIGHT            BT_UUID_DECLARE_128(BT_UUID_SMARTLIGHT_VAL)
#define BT_UUID_SMARTLIGHT_POWER      BT_UUID_DECLARE_128(BT_UUID_SMARTLIGHT_POWER_VAL)
#define BT_UUID_SMARTLIGHT_BRIGHTNESS BT_UUID_DECLARE_128(BT_UUID_SMARTLIGHT_BRIGHTNESS_VAL)
#define BT_UUID_SMARTLIGHT_MODE       BT_UUID_DECLARE_128(BT_UUID_SMARTLIGHT_MODE_VAL)
#define BT_UUID_SMARTLIGHT_STATUS     BT_UUID_DECLARE_128(BT_UUID_SMARTLIGHT_STATUS_VAL)

void button_changed(uint32_t button_state, uint32_t has_changed);

#endif /* LIGHT_H_ */
```
